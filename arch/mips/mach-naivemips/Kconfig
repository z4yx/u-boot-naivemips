## arch/mips/mach-naivemips/Kconfig
```kconfig
menu "NaiveMIPS platforms"
    depends on MACH_NAIVEMIPS

choice
    prompt "Board select"

config TARGET_NAIVEMIPS_THINPAD
    bool "Thinpad board 2017"

config TARGET_NAIVEMIPS_K7EES
    bool "Thinpad board with Kintex-7 by E-Elements"

config TARGET_NAIVEMIPS_NSCSCC
    bool "FPGA-K7 board used in NSCSCC"

endchoice

source "board/thucst/Kconfig"
source "board/e-elements/Kconfig"
source "board/nscscc/Kconfig"

endmenu
```

## board/e-elements/Kconfig
```kconfig
if TARGET_NAIVEMIPS_K7EES

config SYS_BOARD
    default "thinpad_k7"

config SYS_VENDOR
    default "e-elements"

config SYS_CONFIG_NAME
    default "naivemips_k7ees"

config SYS_TEXT_BASE
    default 0x80000000

endif
```

## board/nscscc/Kconfig
```kconfig
if TARGET_NAIVEMIPS_NSCSCC

config SYS_BOARD
    default "FPGA-A7"

config SYS_VENDOR
    default "nscscc"

config SYS_CONFIG_NAME
    default "naivemips_nscscc"

config SYS_TEXT_BASE
    default 0x80000000

endif
```
